## drivers/input/fingerprint/Kconfig
```kconfig
#
# Input fingerprint drivers configuration
#
menuconfig INPUT_FINGERPRINT
	bool "FingerPrint devices"
        default y
	help
	  Say Y here, and a list of fingerprint input drivers will be displayed.
	  Everything that didn't fit into the other categories is here. This option
	  doesn't affect the kernel.

	  If unsure, say Y.

if INPUT_FINGERPRINT

config INPUT_FINGERPRINT_FPC
	tristate "FPC fingerprint support"
        default y
	help
	  Say Y here if you have a FPC fingerprint device and want to enable
	  support for the built-in touchscreen.

	  If unsure, say N.

source "drivers/input/fingerprint/fpc/Kconfig"

config FINGERPRINT_FPC_TEE
	tristate "FPC fingerprint TEE IRQ bridge"
	depends on SPI_MASTER
	default n
	help
	  Expose the IRQ, wakeup, clock and secure-OS boost controls used by
	  the production FPC Trustonic userspace. Sensor capture and matching
	  remain inside the trusted application; normal-world SPI transfers
	  are deliberately not exposed.

endif
```
